/dts-v1/;
/plugin/;

/ {
    /* Совместимость с контроллером вашего текущего ядра */
    compatible = "allwinner,sun60iw2", "allwinner,sunxi";

    fragment@0 {
        target = <&spi3>;
        __overlay__ {
            status = "okay";
            #address-cells = <1>;
            #size-cells = <0>;
            
            /* На некоторых ядрах Allwinner обязательно принудительно */
            /* расширять количество чипселектов и указывать аппаратный пин */
            num-cs = <2>;
            
            /* Отключаем стандартный spidev, чтобы освободить CS1 */
            spidev@1 {
                status = "disabled";
            };

            st7789v@1 {
                /* Используем точное имя, которое ищет ваш модуль ядра fb_st7789v */
                compatible = "sitronix,fb_st7789v", "sitronix,st7789v";
                reg = <1>; /* Использовать CS1 */
                status = "okay";
                
                /* Безопасная частота обмена данными */
                spi-max-frequency = <32000000>; 
                
                /* Обязательные параметры для sunxi-spi контроллера */
                spi-rx-bus-width = <1>;
                spi-tx-bus-width = <1>;
                bits-per-word = <8>;

                /* Принудительные флаги фазы, без которых контроллер выдает ошибку -22 */
                spi-cpol;
                spi-cpha;

                /* Параметры геометрии матрицы дисплея */
                width = <240>;
                height = <320>;
                buswidth = <8>;
                regwidth = <8>;
                rotate = <90>;
                fps = <30>;

                /* Маппинг управляющих пинов Allwinner (Секция 3 = Port D) */
                reset-gpios = <&pio 3 0 1>; /* PD0: Порт 3, Пин 0, Active Low */
                dc-gpios = <&pio 3 1 0>;    /* PD1: Порт 3, Пин 1, Active High */
                bgr;
                init = <0x1000011
                0x20000ff
                0x1000036 0x000000a0
                0x100003a 0x00000005
                0x1000020
                0x100002a 0x00000000 0x00000001 0x00000000 0x0000003f
                0x100002b 0x00000000 0x00000000 0x00000000 0x000000ef
                0x10000b2 0x0000000c 0x0000000c 0x00000000 0x00000033 0x00000033
                0x10000b7 0x00000035
                0x10000bb 0x0000001f
                0x10000c0 0x0000000c
                0x10000c2 0x00000001
                0x10000c3 0x00000012
                0x10000c4 0x00000020
                0x10000c6 0x0000000f
                0x10000d0 0x000000a4 0x000000a1
                0x10000e0 0x000000d0 0x00000008 0x00000011 0x00000008 0x0000000c 0x00000015 0x00000039 0x00000033 0x00000050 0x00000036 0x00000013 0x00000014 0x00000029 0x0000002d
                0x10000e1 0x000000d0 0x00000008 0x00000010 0x00000008 0x00000006 0x00000006 0x00000039 0x00000044 0x00000051 0x0000000b 0x00000016 0x00000014 0x0000002f 0x00000031
                0x1000029>;
            };
        };
    };
};

